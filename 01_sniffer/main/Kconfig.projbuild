## 01_sniffer/main/Kconfig.projbuild
```kconfig
menu "CSI sniffer configuration"

    config CSI_SNIFFER_CHANNEL
        int "Channel to park on"
        range 1 177
        default 36
        help
            2.4 GHz: 1-14.
            5 GHz:   36-64, 100-144, 149-177, in steps of 4.

            36 is the default because it is a non-DFS 5 GHz channel that most
            dual-band APs use out of the box, and 5 GHz is the reason to pick a
            C5 over a C6 in the first place. Use 1 or 6 or 11 if the traffic you
            care about is on 2.4 GHz.

            Channels 52-144 are DFS. A C5 in promiscuous mode only listens, so
            receiving there is fine, but many APs avoid them and you may see no
            traffic at all.

    config CSI_SNIFFER_PRINT_CSV
        bool "Print one CSV line per record"
        default y
        help
            Turn this off to keep only the periodic summary. Useful when you
            want to check that CSI is flowing without drowning the console.

    config CSI_SNIFFER_DUMP_ACK
        bool "Also produce CSI for received 802.11 ACK frames"
        default y
        help
            ACKs are short, frequent and sent at a legacy rate, which makes them
            a dense and very regular CSI source. This maps to the dump_ack_en
            field of wifi_csi_acquire_config_t.

    config CSI_SNIFFER_FORCE_LLTF
        bool "Report L-LTF instead of HT/VHT/HE-LTF"
        default n
        help
            This maps to acquire_csi_force_lltf. On the C5 an HT/VHT/HE frame
            carries two LTF sequences and you get exactly one of them - and the
            choice silently changes the buffer format as well:

              n (default) - HT/VHT/HE-LTF. 8-bit int8 pairs, two bytes per tone.
                            245 tones in a 490-byte record for an HE20 frame,
                            the most frequency resolution available.
              y           - L-LTF only, always 106 bytes, the same shape no
                            matter which PHY the frame used. But L-LTF defaults
                            to 12-BIT packing on this chip: four bytes per tone,
                            26 tones, not 53.

            The 12-bit behaviour is undocumented - ESP-IDF's CSI page still says
            two bytes per sub-carrier - and reading it as int8 pairs produces
            data that "parses cleanly and plots plausibly" while being wrong.
            The shared component decodes both and tags each record in the
            "packing" CSV column.

    config CSI_SNIFFER_VAL_SCALE
        int "CSI value scaling (val_scale_cfg)"
        range 0 8
        default 0
        help
            Scales the reported I/Q values. The C5 accepts 0-8; the C6 field is
            only two bits wide and stops at 3.

            ESP-IDF documents nothing about this field except its range - not
            what the values mean, and not whether 0 is special. So treat it
            empirically: leave it at 0, look at the printed values, and only
            change it if they clip at +/-127 or sit down in the noise.

    config CSI_SNIFFER_QUEUE_LEN
        int "CSI records buffered between the Wi-Fi task and the printer"
        range 4 64
        default 16
        help
            Each slot is roughly 600 bytes. Raise it if the summary line reports
            drops, lower it if you are short of RAM. Records are dropped rather
            than blocking, because blocking in the CSI callback stalls the whole
            Wi-Fi stack.

endmenu
```

## 02_espnow_pair/rx/main/Kconfig.projbuild
```kconfig
menu "CSI receiver configuration"

    config CSI_RX_CHANNEL
        int "Channel to listen on"
        range 1 177
        default 36
        help
            Must match CSI_TX_CHANNEL on the transmitter board exactly.

    config CSI_RX_FILTER_MAC
        string "Only report CSI from this transmitter MAC"
        default "00:00:00:00:00:00"
        help
            Format aa:bb:cc:dd:ee:ff. The transmitter prints its own address at
            boot; paste it here.

            Leave it all zeros to report CSI from every transmitter on the
            channel, which is what you want when you are still checking that
            anything arrives at all.

    config CSI_RX_PRINT_CSV
        bool "Print the full CSV line per record"
        default y
        help
            Turn this off to keep only the one-line AMP summary, which is far
            easier to read while you are physically moving around the room.

    config CSI_RX_FORCE_LLTF
        bool "Report L-LTF instead of HT/VHT/HE-LTF"
        default n
        help
            Maps to acquire_csi_force_lltf. Say n for the full HE-LTF
            resolution the C5 is capable of - 8-bit int8 pairs, two bytes per
            tone, 245 tones for an HE20 frame.

            Say y for L-LTF: always a 106-byte record whatever the transmitter
            used. Note that L-LTF on the C5 defaults to 12-bit packing, which is
            four bytes per tone and 26 tones - undocumented, and the usual cause
            of silently wrong CSI on this chip. The shared component handles it
            and reports which format each record used in the "packing" column.

            In this example the transmitter's PHY is pinned anyway, so record
            shape is already stable and there is little reason to force L-LTF.

    config CSI_RX_VAL_SCALE
        int "CSI value scaling (val_scale_cfg)"
        range 0 8
        default 0
        help
            Scales the reported I/Q values. ESP-IDF documents only the range,
            0-8 on the C5, so this is a knob to sweep rather than one to reason
            about. Start at 0 and change it only if the AMP figures clip or
            vanish into the noise.

endmenu
```

## 02_espnow_pair/tx/main/Kconfig.projbuild
```kconfig
menu "CSI transmitter configuration"

    config CSI_TX_CHANNEL
        int "Channel to transmit on"
        range 1 177
        default 36
        help
            Must match CSI_RX_CHANNEL on the receiver board exactly. ESP-NOW
            refuses to send when the peer channel and the radio channel disagree
            (ESP_ERR_ESPNOW_CHAN).

            2.4 GHz: 1-14. 5 GHz: 36-64, 100-144, 149-177 in steps of 4.

    config CSI_TX_INTERVAL_MS
        int "Milliseconds between frames"
        range 5 5000
        default 20
        help
            20 ms gives 50 CSI records per second, which is a reasonable rate for
            watching a person move through the link. Go down to 10 ms for gesture
            work; below that the console becomes the bottleneck before the radio
            does.

    config CSI_TX_PAYLOAD_PAD
        int "Extra payload bytes"
        range 1 200
        default 24
        help
            CSI is estimated from the preamble, so payload length does not change
            what is measured. A little payload just makes the frames easier to
            spot in a sniffer trace. The minimum is 1 rather than 0 because a
            zero-length array member is a compiler extension, not standard C.

    config CSI_TX_PHY_HE20
        bool "Transmit as 802.11ax HE20 instead of legacy"
        default y
        help
            y - HE20 MCS0. The receiver gets HE-LTF CSI: 245 sub-carriers in a
                490 byte record. This is the C5 showing off what a Wi-Fi 6 radio
                measures, and it is the highest frequency resolution available.

            n - legacy 6 Mbps (11g on 2.4 GHz, 11a on 5 GHz). The receiver gets
                L-LTF CSI: 52 sub-carriers in a 106 byte record. Smaller, and
                directly comparable with CSI captured from older ESP32 chips.

endmenu
```

## 03_router/main/Kconfig.projbuild
```kconfig
menu "CSI from a router configuration"

    config CSI_ROUTER_SSID
        string "Access point SSID"
        default "myssid"

    config CSI_ROUTER_PASSWORD
        string "Access point password"
        default "mypassword"
        help
            Leave empty for an open network.

    choice CSI_ROUTER_BAND
        prompt "Band to use"
        default CSI_ROUTER_BAND_AUTO
        help
            The C5 can associate on either band. Pinning it is the only way to
            be sure which one you measured when the AP advertises the same SSID
            on both - and measuring a 5 GHz link is the reason to use a C5 here
            rather than any other Espressif part.

        config CSI_ROUTER_BAND_AUTO
            bool "Either (WIFI_BAND_MODE_AUTO)"
        config CSI_ROUTER_BAND_5G_ONLY
            bool "5 GHz only"
        config CSI_ROUTER_BAND_2G_ONLY
            bool "2.4 GHz only"
    endchoice

    config CSI_ROUTER_INTERVAL_MS
        int "Milliseconds between pings"
        range 5 5000
        default 20
        help
            Sets the CSI rate: roughly one echo reply, and so one CSI record,
            per ping. 20 ms gives about 50 records per second.

            esp_ping schedules with vTaskDelayUntil() at this interval, so with
            the project's CONFIG_FREERTOS_HZ=1000 anything down to a few
            milliseconds is honoured. The real floor is the round-trip time: if
            the gateway takes longer than the interval to answer, the rate drops
            to whatever the link sustains.

    config CSI_ROUTER_PRINT_CSV
        bool "Print one CSV line per record"
        default y

    config CSI_ROUTER_FORCE_LLTF
        bool "Report L-LTF instead of HT/VHT/HE-LTF"
        default n
        help
            Say y to see the other buffer format. On the C5 this does two
            things, not one:

              n - HT/VHT/HE-LTF, 8-bit int8 pairs, two bytes per tone. Record
                  length follows whatever PHY the AP's rate control picked:
                  490 for HE20, 234 for HT40, 114 for HT20.
              y - L-LTF only, always 106 bytes - but in 12-bit packing, which is
                  FOUR bytes per tone and yields 26 tones, not 53.

            That second effect is undocumented: ESP-IDF's CSI page still says
            two bytes per sub-carrier for every case on this chip. The shared
            component decodes both and labels each record in the "packing" CSV
            column, so it is safe to toggle here - but any external tool you
            feed the CSV to has to respect that column.

    config CSI_ROUTER_VAL_SCALE
        int "CSI value scaling (val_scale_cfg)"
        range 0 8
        default 0
        help
            Scales the reported I/Q values. ESP-IDF documents only the range,
            0-8 on the C5. Leave it at 0 unless the printed values clip at
            +/-127 or sit in the noise.

endmenu
```

## 04_motion/main/Kconfig.projbuild
```kconfig
menu "CSI motion detector configuration"

    config CSI_MOTION_SSID
        string "Access point SSID"
        default "myssid"

    config CSI_MOTION_PASSWORD
        string "Access point password"
        default "mypassword"

    config CSI_MOTION_INTERVAL_MS
        int "Milliseconds between pings"
        range 5 1000
        default 20
        help
            Also sets the CSI rate, and therefore what the detector can see. A
            person walking takes a few hundred milliseconds to cross a link, so
            20 ms (50 records per second) gives plenty of samples per event.

    config CSI_MOTION_CALIBRATION_RECORDS
        int "Records to average into the baseline before watching"
        range 20 2000
        default 250
        help
            At the default 20 ms interval, 250 records is about five seconds.
            Stay out of the path between the board and the AP for that long
            after boot, or you calibrate your own presence into the baseline and
            the detector then reports motion when you leave.

    config CSI_MOTION_THRESHOLD_PERCENT
        int "Motion threshold, percent mean deviation"
        range 1 200
        default 15
        help
            The score is the mean relative change in per-sub-carrier amplitude
            against the baseline, so 15 means "on average 15 percent away from
            what the room looked like when still".

            This number is not portable. It depends on the distance between the
            board and the AP, on what is in the room, and on the band. Watch the
            MOTION lines with the room empty and with someone walking through,
            then set it between the two.

    config CSI_MOTION_HOLD_MS
        int "Minimum milliseconds to hold the motion state"
        range 0 10000
        default 1500
        help
            Stops one person crossing the link from being reported as a rapid
            series of separate events.

    config CSI_MOTION_FORCE_LLTF
        bool "Report L-LTF instead of HT/VHT/HE-LTF"
        default n
        help
            Leave this at n unless you have a specific reason.

            The obvious argument for y is stable record shape: traffic from a
            real AP arrives in whatever PHY its rate control picked, so record
            length keeps moving between 490, 234, 114 and 106 bytes, and the
            detector can only compare sub-carrier k against baseline
            sub-carrier k when k means the same frequency every time.

            The argument against is stronger. On the C5, forcing L-LTF also
            switches the buffer to 12-bit packing - four bytes per tone instead
            of two - which is undocumented and is the single most common way to
            get silently wrong CSI on this chip. The shared component decodes
            both correctly, so it is safe either way here, but Espressif's own
            recommendation for human sensing is to leave it off:

              "234 subcarriers are sufficient to capture human body state
               features [...] 8-bit precision is completely adequate for
               detecting sitting/standing/walking"

            The detector does not need a globally fixed shape anyway - records
            whose shape does not match the baseline are counted and discarded
            rather than compared, and the summary reports them as "wrong-shape".
            If that count is high, the cheaper fix is to pin the link (an
            11n 40 MHz connection gives a steady 234) rather than to force
            L-LTF.

    config CSI_MOTION_VAL_SCALE
        int "CSI value scaling (val_scale_cfg)"
        range 0 8
        default 0
        help
            Scales the reported I/Q values; ESP-IDF documents only the range,
            0-8 on the C5. Because the detector works on relative change against
            its own baseline, a change here mostly rescales the score, so if you
            do change it, re-tune the threshold too.

endmenu
```

## 05_band_sweep/main/Kconfig.projbuild
```kconfig
menu "CSI band sweep configuration"

    choice CSI_SWEEP_BAND
        prompt "Bands to sweep"
        default CSI_SWEEP_BAND_BOTH

        config CSI_SWEEP_BAND_BOTH
            bool "Both (2.4 GHz then 5 GHz)"
        config CSI_SWEEP_BAND_24
            bool "2.4 GHz only"
        config CSI_SWEEP_BAND_5
            bool "5 GHz only"
    endchoice

    config CSI_SWEEP_DWELL_MS
        int "Milliseconds to dwell on each channel"
        range 100 10000
        default 800
        help
            The sweep is passive: it counts what other people transmit, so a
            short dwell on a quiet channel proves nothing. 800 ms across 32
            channels is roughly a 26 second pass.

            Raise it to 2000 or more if you are trying to establish that a
            channel really is empty rather than merely quiet at that moment.
            Beacons alone arrive about every 100 ms per AP, so anything above a
            few hundred milliseconds will find an AP if one is there.

endmenu
```
